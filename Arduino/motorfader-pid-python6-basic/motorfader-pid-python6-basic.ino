#include "PID.hpp"
#include "SerialInput.hpp"
#include "Hysteresis.hpp"

const uint8_t signal[] PROGMEM = {
  0,1,2,3,4,5,6,7,8,9,10,11,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126,
  127,128,129,130,131,132,133,134,135,136,137,138,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255,
  255,254,253,252,251,250,249,248,247,246,245,244,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127,
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  0,  0,  0,  0,  0,  0,  0,  0,  0,  0,  0,  0,  0,  0,  0,  0,
};

#define LEN(x) (sizeof(x) / sizeof(*x))

const size_t len = LEN(signal);

const unsigned long Ts = 1000; // microseconds

const uint16_t forward = 9;
const uint16_t backward = 10;
const uint16_t enable = 4;

/*PID pid = {
  0.6,
  0.00,
  0.0001,
  Ts * 1e-6 // seconds
};*/

PID pid = {
  0,
  0,
  0,
  Ts * 1e-6 // seconds
};

constexpr uint8_t HYST_BITS = 2;

EMA_f ema = 0.8;
Hysteresis<HYST_BITS> hyst;

StreamInput<16> serIn(Serial);

void setup() {
  pinMode(forward, OUTPUT);
  pinMode(backward, OUTPUT);
  pinMode(enable, OUTPUT);
  digitalWrite(enable, HIGH);
  Serial.begin(115200);
  pid.set(64);
  
  // 1 → /1
  // 2 → /8
  // 3 → /64
  // 4 → /256
  // 5 → /1024
  TCCR1B = TCCR1B & 0b11111000 | 1 ;
}

const int16_t knee = 30 * 2;
// const int16_t knee = 40;

uint8_t activation(int16_t val) {
  if (val == 0)
    return 0;
  else
    return map(val, 0, 255, knee, 255);
}

void writeMotor(int16_t val) {
  if (val >= 0) {
    analogWrite(forward, activation(val));
    digitalWrite(backward, 0);
  } else {
    analogWrite(backward, activation(-val));
    digitalWrite(forward, 0);
  }
}

void print(int16_t target, int16_t val, int16_t output) {
  Serial.print(target); Serial.print('\t');
  Serial.print(val); Serial.print('\t');
  Serial.println(output);
  Serial.flush();
}

const char EOT = 0x04;
const char ACK = 0x06;

void loop() {
  char serVal = serIn.check();
  switch (serVal) {
    case 'p':
      pid.setProp(serIn.getValue());
      Serial.print(ACK);
      break;
    case 'i':
      pid.setInt(serIn.getValue());
      Serial.print(ACK);
      break;
    case 'd':
      pid.setDeriv(serIn.getValue());
      Serial.print(ACK);
      break;
    case 'g':
      Serial.print(ACK);
      run();
      Serial.print(EOT);
      break;
  }
}

void run() {
  unsigned long prevMicros = micros();
  size_t index = 0;
  bool running = true;
  size_t counter = 0;

  while (running) {
    if (micros() - prevMicros >= Ts) {
      if (counter >= 10) {
        counter = 0;
      }
      if (counter == 0) {
        pid.set(pgm_read_byte(signal + index) * 4);
        index++;
        running = index < len;
      }
      hyst.update(ema(analogRead(A0)));
      auto output = hyst.getValue() << HYST_BITS;
      int16_t control = pid.update(output);
      writeMotor(control);
      print(pid.getSetPoint(), control, output);
      prevMicros += Ts;
      counter++;
    }
  }
  writeMotor(0);
}
